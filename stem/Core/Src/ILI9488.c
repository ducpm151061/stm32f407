#include "DataDefine.h"
#include "ILI9488.h"
#include "Hardware.h"
#include "font.h"
//===========================================================================================================
//===========================================================================================================
//===========================================================================================================
uint16_t MAX_X = LCD_WITDH_SIZE;
uint16_t MAX_Y = LCD_HIGH_SIZE;
//===========================================================================================================
//===========================================================================================================
//===========================================================================================================

//===========================================================================================================
//===========================================================================================================
//===========================================================================================================
/**
    * @brief    Initializes ILI9488
    * @param    None
    * @retval   None
    */
void ILI9488_Init(void)
{
    GPIO_InitTypeDef GPIO_InitStructure;
    //========================================================================================================
    //========================================================================================================
    //Enables ILI9488_PWR_CTRL's Control Pin Clock
    RCC_AHB1PeriphClockCmd(ILI9488_PWR_CTRL_PORT_RCC, ENABLE);

    //Configures ILI9488_PWR_CTRL's Control Pin is GPIO, Output Mode, 100MHz, Pull Up
    GPIO_InitStructure.GPIO_Pin = ILI9488_PWR_CTRL;
    GPIO_InitStructure.GPIO_Mode = GPIO_Mode_OUT;
    GPIO_InitStructure.GPIO_OType = GPIO_OType_PP;
    GPIO_InitStructure.GPIO_Speed = GPIO_Speed_100MHz;
    GPIO_InitStructure.GPIO_PuPd = GPIO_PuPd_NOPULL;
    GPIO_Init(ILI9488_PWR_CTRL_PORT, &GPIO_InitStructure);

    //Sets ILI9488_PWR_CTRL to Power On ILI9488
    GPIO_SetBits(ILI9488_PWR_CTRL_PORT, ILI9488_PWR_CTRL);
    //========================================================================================================
    //Enables ILI9488_BL_CTRL's Control Pin Clock
    RCC_AHB1PeriphClockCmd(ILI9488_BL_CTRL_PORT_RCC, ENABLE);

    //Configures ILI9488_BL_CTRL's Control Pin is GPIO, Output Mode, 100MHz, Pull Up
    GPIO_InitStructure.GPIO_Pin = ILI9488_BL_CTRL;
    GPIO_InitStructure.GPIO_Mode = GPIO_Mode_OUT;
    GPIO_InitStructure.GPIO_OType = GPIO_OType_PP;
    GPIO_InitStructure.GPIO_Speed = GPIO_Speed_100MHz;
    GPIO_InitStructure.GPIO_PuPd = GPIO_PuPd_NOPULL;
    GPIO_Init(ILI9488_BL_CTRL_PORT, &GPIO_InitStructure);

    //Sets ILI9488_BL_CTRL to Turns On Backlight
    GPIO_SetBits(ILI9488_BL_CTRL_PORT, ILI9488_BL_CTRL);
    //========================================================================================================
    //Enables ILI9488_DC's Control Pin Clock
    RCC_AHB1PeriphClockCmd(ILI9488_DC_PORT_RCC, ENABLE);

    //Configures ILI9488_DC's Control Pin is GPIO, Output Mode, 100MHz, Pull Up
    GPIO_InitStructure.GPIO_Pin = ILI9488_DC;
    GPIO_InitStructure.GPIO_Mode = GPIO_Mode_OUT;
    GPIO_InitStructure.GPIO_OType = GPIO_OType_PP;
    GPIO_InitStructure.GPIO_Speed = GPIO_Speed_100MHz;
    GPIO_InitStructure.GPIO_PuPd = GPIO_PuPd_NOPULL;
    GPIO_Init(ILI9488_DC_PORT, &GPIO_InitStructure);

    //Sets Initial Value For ILI9488_DC Signal
    GPIO_SetBits(ILI9488_DC_PORT, ILI9488_DC);
    //========================================================================================================
    //Enables ILI9488_WRX's Control Pin Clock
    RCC_AHB1PeriphClockCmd(ILI9488_WRX_PORT_RCC, ENABLE);

    //Configures ILI9488_WRX's Control Pin is GPIO, Output Mode, 100MHz, Pull Up
    GPIO_InitStructure.GPIO_Pin = ILI9488_WRX;
    GPIO_InitStructure.GPIO_Mode = GPIO_Mode_OUT;
    GPIO_InitStructure.GPIO_OType = GPIO_OType_PP;
    GPIO_InitStructure.GPIO_Speed = GPIO_Speed_100MHz;
    GPIO_InitStructure.GPIO_PuPd = GPIO_PuPd_NOPULL;
    GPIO_Init(ILI9488_WRX_PORT, &GPIO_InitStructure);

    //Sets Initial Value For ILI9488_WRX Signal
    GPIO_SetBits(ILI9488_WRX_PORT, ILI9488_WRX);
    //========================================================================================================
    //Enables ILI9488_RD's Control Pin Clock
    RCC_AHB1PeriphClockCmd(ILI9488_RD_PORT_RCC, ENABLE);

    //Configures ILI9488_RD's Control Pin is GPIO, Output Mode, 100MHz, Pull Up
    GPIO_InitStructure.GPIO_Pin = ILI9488_RD;
    GPIO_InitStructure.GPIO_Mode = GPIO_Mode_OUT;
    GPIO_InitStructure.GPIO_OType = GPIO_OType_PP;
    GPIO_InitStructure.GPIO_Speed = GPIO_Speed_100MHz;
    GPIO_InitStructure.GPIO_PuPd = GPIO_PuPd_NOPULL;
    GPIO_Init(ILI9488_RD_PORT, &GPIO_InitStructure);

    //Sets Initial Value For ILI9488_RD Signal
    GPIO_SetBits(ILI9488_RD_PORT, ILI9488_RD);
    //========================================================================================================
    //Enables ILI9488_CS's Control Pin Clock
    RCC_AHB1PeriphClockCmd(ILI9488_CS_PORT_RCC, ENABLE);

    //Configures ILI9488_CS's Control Pin is GPIO, Output Mode, 100MHz, Pull Up
    GPIO_InitStructure.GPIO_Pin = ILI9488_CS;
    GPIO_InitStructure.GPIO_Mode = GPIO_Mode_OUT;
    GPIO_InitStructure.GPIO_OType = GPIO_OType_PP;
    GPIO_InitStructure.GPIO_Speed = GPIO_Speed_100MHz;
    GPIO_InitStructure.GPIO_PuPd = GPIO_PuPd_NOPULL;
    GPIO_Init(ILI9488_CS_PORT, &GPIO_InitStructure);

    //Resets Initial Value For ILI9488_CS Signal
    GPIO_ResetBits(ILI9488_CS_PORT, ILI9488_CS);
    //========================================================================================================
    //========================================================================================================

    //========================================================================================================
    //========================================================================================================
    //Enables ILI9488_DATA's Control Pin Clock
    RCC_AHB1PeriphClockCmd(RCC_AHB1Periph_GPIOE, ENABLE);

    //Configures ILI9488_DATA's Control Pin is GPIO, Output Mode, 100MHz, Pull Up
    GPIO_InitStructure.GPIO_Pin = 0xFFFF;
    GPIO_InitStructure.GPIO_Mode = GPIO_Mode_OUT;
    GPIO_InitStructure.GPIO_OType = GPIO_OType_PP;
    GPIO_InitStructure.GPIO_Speed = GPIO_Speed_100MHz;
    GPIO_InitStructure.GPIO_PuPd = GPIO_PuPd_NOPULL;
    GPIO_Init(GPIOE, &GPIO_InitStructure);
    //========================================================================================================
    //========================================================================================================

    //========================================================================================================
    //========================================================================================================
    //Enables ILI9488_RST's Control Pin Clock
    RCC_AHB1PeriphClockCmd(ILI9488_RST_PORT_RCC, ENABLE);

    //Configures ILI9488_RST's Control Pin is GPIO, Output Mode, 100MHz, Pull Up
    GPIO_InitStructure.GPIO_Pin = ILI9488_RST;
    GPIO_InitStructure.GPIO_Mode = GPIO_Mode_OUT;
    GPIO_InitStructure.GPIO_OType = GPIO_OType_PP;
    GPIO_InitStructure.GPIO_Speed = GPIO_Speed_100MHz;
    GPIO_InitStructure.GPIO_PuPd = GPIO_PuPd_NOPULL;
    GPIO_Init(ILI9488_RST_PORT, &GPIO_InitStructure);

    //Resets ILI9488
    GPIO_SetBits(ILI9488_RST_PORT, ILI9488_RST);
    DelayMS(5);

    GPIO_ResetBits(ILI9488_RST_PORT, ILI9488_RST);
    DelayMS(10);

    GPIO_SetBits(ILI9488_RST_PORT, ILI9488_RST);
    DelayMS(120);
    //========================================================================================================
    //========================================================================================================

    //========================================================================================================
    //========================================================================================================
    ILI9488_Write_Command(ILI9488_Positive_Gamma_Control);
    ILI9488_Write_Command_Data(0x00);
    ILI9488_Write_Command_Data(0x03);
    ILI9488_Write_Command_Data(0x09);
    ILI9488_Write_Command_Data(0x08);
    ILI9488_Write_Command_Data(0x16);
    ILI9488_Write_Command_Data(0x0A);
    ILI9488_Write_Command_Data(0x3F);
    ILI9488_Write_Command_Data(0x78);
    ILI9488_Write_Command_Data(0x4C);
    ILI9488_Write_Command_Data(0x09);
    ILI9488_Write_Command_Data(0x0A);
    ILI9488_Write_Command_Data(0x08);
    ILI9488_Write_Command_Data(0x16);
    ILI9488_Write_Command_Data(0x1A);
    ILI9488_Write_Command_Data(0x0F);
    //========================================================================================================
    ILI9488_Write_Command(ILI9488_Negative_Gamma_Control);
    ILI9488_Write_Command_Data(0x00);
    ILI9488_Write_Command_Data(0x16);
    ILI9488_Write_Command_Data(0x19);
    ILI9488_Write_Command_Data(0x03);
    ILI9488_Write_Command_Data(0x0F);
    ILI9488_Write_Command_Data(0x05);
    ILI9488_Write_Command_Data(0x32);
    ILI9488_Write_Command_Data(0x45);
    ILI9488_Write_Command_Data(0x46);
    ILI9488_Write_Command_Data(0x04);
    ILI9488_Write_Command_Data(0x0E);
    ILI9488_Write_Command_Data(0x0D);
    ILI9488_Write_Command_Data(0x35);
    ILI9488_Write_Command_Data(0x37);
    ILI9488_Write_Command_Data(0x0F);
    //========================================================================================================
    ILI9488_Write_Command(ILI9488_Power_Control_1); //Power Control 1
    ILI9488_Write_Command_Data(0x17);               //Vreg1out
    ILI9488_Write_Command_Data(0x15);               //Verg2out
    //========================================================================================================
    ILI9488_Write_Command(ILI9488_Power_Control_2); //Power Control 2
    ILI9488_Write_Command_Data(0x41);               //VGH,VGL
    //========================================================================================================
    ILI9488_Write_Command(ILI9488_VCOM_Control); //VCOM
    ILI9488_Write_Command_Data(0x00);
    ILI9488_Write_Command_Data(0x12);
    ILI9488_Write_Command_Data(0x80);
    //========================================================================================================
    ILI9488_Write_Command(ILI9488_Memory_Access_Control); //Memory Access
    ILI9488_Write_Command_Data(0x48);
    //========================================================================================================
    ILI9488_Write_Command(ILI9488_Interface_Pixel_Format); //Interface Pixel Format
    ILI9488_Write_Command_Data(0x55);                      //16 bit
    //========================================================================================================
    ILI9488_Write_Command(ILI9488_Interface_Mode_Control); //Interface Mode Control
    ILI9488_Write_Command_Data(0x00);
    //========================================================================================================
    ILI9488_Write_Command(ILI9488_Frame_Control_Normal_Mode); //Frame rate
    ILI9488_Write_Command_Data(0xA0);                         //60Hz
    //========================================================================================================
    ILI9488_Write_Command(ILI9488_Display_Inversion_Control); //Display Inversion Control
    ILI9488_Write_Command_Data(0x02);                         //2-dot
    //========================================================================================================
    ILI9488_Write_Command(ILI9488_Display_Function_Control); //Display Function Control
    ILI9488_Write_Command_Data(0x02);                        //MCU
    ILI9488_Write_Command_Data(0x02);                        //Source,Gate scan Direction
    //========================================================================================================
    ILI9488_Write_Command(ILI9488_Set_Image_Function); //Set Image Function
    ILI9488_Write_Command_Data(0x00);                  //Disable 24 bit data
    //========================================================================================================
    ILI9488_Write_Command(ILI9488_Adjust_Control_3); //Adjust Control
    ILI9488_Write_Command_Data(0xA9);
    ILI9488_Write_Command_Data(0x51);
    ILI9488_Write_Command_Data(0x2C);
    ILI9488_Write_Command_Data(0x82); //D7 stream, loose
    //========================================================================================================
    ILI9488_Write_Command(ILI9488_Sleep_OUT); //Sleep Out
    DelayMS(120);
    //========================================================================================================
    ILI9488_Write_Command(ILI9488_Display_ON); //Display On
    //========================================================================================================
    //========================================================================================================
}
//===========================================================================================================
//===========================================================================================================
//===========================================================================================================
/**
    * @brief    Power On ILI9488
    * @param    None
    * @retval   None
    */
void ILI9488_PowerOn(void)
{
    //========================================================================================================
    //Sets ILI9488_PWR_CTRL to Power On ILI9488
    GPIO_SetBits(ILI9488_PWR_CTRL_PORT, ILI9488_PWR_CTRL);
    //========================================================================================================
}
//===========================================================================================================
//===========================================================================================================
//===========================================================================================================
/**
    * @brief    Power Off ILI9488
    * @param    None
    * @retval   None
    */
void ILI9488_PowerOff(void)
{
    //========================================================================================================
    //Resets ILI9488_PWR_CTRL to Power Off ILI9488
    GPIO_ResetBits(ILI9488_PWR_CTRL_PORT, ILI9488_PWR_CTRL);
    //========================================================================================================
}
//===========================================================================================================
//===========================================================================================================
//===========================================================================================================
/**
    * @brief    Writes Command to ILI9488
    * @param    + Command Code
    * @retval   None
    */
void ILI9488_Write_Command(uint16_t Command)
{
    //========================================================================================================
    //========================================================================================================
    //Resets ILI9488_DC Signal For Write Command
    //GPIO_ResetBits(ILI9488_DC_PORT, ILI9488_DC);
    *((uint32_t *)&GPIOB->BSRRL) = BIT5 << 16;
    //========================================================================================================
    //========================================================================================================
    //Resets ILI9488_CS Signal to Select ILI9488
    //GPIO_ResetBits(ILI9488_CS_PORT, ILI9488_CS);
    //========================================================================================================
    //========================================================================================================
    //Resets ILI9488_WRX Signal
    //GPIO_ResetBits(ILI9488_WRX_PORT, ILI9488_WRX);
    *((uint32_t *)&GPIOB->BSRRL) = BIT6 << 16;
    //========================================================================================================
    //========================================================================================================
    //Sends Command
    GPIOE->ODR = Command;
    //========================================================================================================
    //========================================================================================================
    //Triggers WR Signal to Write Command
    //GPIO_SetBits(ILI9488_WRX_PORT, ILI9488_WRX);
    *((uint32_t *)&GPIOB->BSRRL) = BIT6;
    //========================================================================================================
    //========================================================================================================
    //Sets ILI9488_CS Signal to Un-Select ILI9488
    //GPIO_SetBits(ILI9488_CS_PORT, ILI9488_CS);
    //========================================================================================================
    //========================================================================================================
    //Sets ILI9488_DC Signal For Write Data
    //GPIO_SetBits(ILI9488_DC_PORT, ILI9488_DC);
    *((uint32_t *)&GPIOB->BSRRL) = BIT5;
    //========================================================================================================
    //========================================================================================================
}
//===========================================================================================================
//===========================================================================================================
//===========================================================================================================
/**
    * @brief    Writes Command Data to ILI9488
    * @param    + Parameter of Command
    * @retval   None
    */
void ILI9488_Write_Command_Data(uint16_t Command_Data)
{
    //========================================================================================================
    //========================================================================================================
    //Sets ILI9488_DC Signal For Write Command Data
    //GPIO_SetBits(ILI9488_DC_PORT, ILI9488_DC);
    //========================================================================================================
    //========================================================================================================
    //Resets ILI9488_CS Signal to Select ILI9488
    //GPIO_ResetBits(ILI9488_CS_PORT, ILI9488_CS);
    //========================================================================================================
    //========================================================================================================
    //Resets ILI9488_WRX Signal
    //GPIO_ResetBits(ILI9488_WRX_PORT, ILI9488_WRX);
    *((uint32_t *)&GPIOB->BSRRL) = BIT6 << 16;
    //========================================================================================================
    //========================================================================================================
    //Sends Data
    GPIOE->ODR = Command_Data;
    //========================================================================================================
    //========================================================================================================
    //Triggers WR Signal to Write Command
    //GPIO_SetBits(ILI9488_WRX_PORT, ILI9488_WRX);
    *((uint32_t *)&GPIOB->BSRRL) = BIT6;
    //========================================================================================================
    //========================================================================================================
    //Sets ILI9488_CS Signal to Un-Select ILI9488
    //GPIO_SetBits(ILI9488_CS_PORT, ILI9488_CS);
    //========================================================================================================
    //========================================================================================================
}
//===========================================================================================================
//===========================================================================================================
//===========================================================================================================

//===========================================================================================================
//===========================================================================================================
//===========================================================================================================
/**
    * @brief    Writes to GGRAM ILI9488
    * @param    + Display Data
    * @retval   None
    */
void ILI9488_Write_GRAM(uint16_t Color)
{
    //========================================================================================================
    //========================================================================================================
    //Sets ILI9488_DC Signal For Write Data
    //GPIO_SetBits(ILI9488_DC_PORT, ILI9488_DC);
    //========================================================================================================
    //========================================================================================================
    //Resets ILI9488_CS Signal to Select ILI9488
    //GPIO_ResetBits(ILI9488_CS_PORT, ILI9488_CS);
    //========================================================================================================
    //========================================================================================================
    //Resets ILI9488_WRX Signal
    //GPIO_ResetBits(ILI9488_WRX_PORT, ILI9488_WRX);
    *((uint32_t *)&GPIOB->BSRRL) = BIT6 << 16;
    //========================================================================================================
    //========================================================================================================
    //Sends Data
    GPIOE->ODR = Color;
    //========================================================================================================
    //========================================================================================================
    //Triggers WR Signal to Write Command
    //GPIO_SetBits(ILI9488_WRX_PORT, ILI9488_WRX);
    *((uint32_t *)&GPIOB->BSRRL) = BIT6;
    //========================================================================================================
    //========================================================================================================
    //Sets ILI9488_CS Signal to Un-Select ILI9488
    //GPIO_SetBits(ILI9488_CS_PORT, ILI9488_CS);
    //========================================================================================================
    //========================================================================================================
}
//===========================================================================================================
//===========================================================================================================
//===========================================================================================================
/**
    * @brief    Converts From BGR to RGB Color Format
    * @param    + Color Code in BGR Format
    * @retval   + Color Code in RGB Format
    */
uint16_t Convert_BGR2RGB(uint16_t Color)
{
    //=======================================================================================================
    uint16_t R = 0;
    uint16_t G = 0;
    uint16_t B = 0;
    uint16_t RGB_Color = 0;
    //=======================================================================================================
    B = ((Color >> 0) & 0x1F);
    G = ((Color >> 5) & 0x3F);
    R = ((Color >> 11) & 0x1F);
    //=======================================================================================================
    RGB_Color = ((B << 11) + (G << 5) + (R << 0));
    //=======================================================================================================
    return RGB_Color;
    //=======================================================================================================
}
//===========================================================================================================
//===========================================================================================================
//===========================================================================================================
/**
    * @brief    Converts From BGR to RGB Color Format
    * @param    + Color Code in BGR Format
    * @retval   + Color Code in RGB Format
    */
uint16_t RGB565_converter(uint8_t R, uint8_t G, uint8_t B)
{
    return (((((uint16_t)R) >> 3) << 11) | ((((uint16_t)G) >> 2) << 5) | (((uint16_t)B) >> 3));
}
//===========================================================================================================
//===========================================================================================================
//===========================================================================================================
/**
    * @brief    Swap 2 Variables
    * @param    + Variable 1
                    + Variable 2
    * @retval   None
    */
void Swap(uint16_t *a, uint16_t *b)
{
    //=======================================================================================================
    uint16_t temp = 0;
    //=======================================================================================================
    temp = *b;
    *b = *a;
    *a = temp;
    //=======================================================================================================
}
////===========================================================================================================
////===========================================================================================================
////===========================================================================================================
///**
//  * @brief    Set Orientation of LCD
//  * @param    + Orientaion Mode
//  * @retval   None
//  */
//void ILI9488_LCD_Set_Orientation(uint8_t Orientation_Mode)
//{
//  //=======================================================================================================
//  ILI9488_Write_Command(ILI9488_Memory_Access_Control);
//  //=======================================================================================================
//  switch(Orientation_Mode)
//  {
//      //===================================================================================================
//      case PORTRAIT_1:
//      {
//          ILI9488_Write_Command_Data(0x58);
//          break;
//      }
//      //===================================================================================================
//      case PORTRAIT_2:
//      {
//          ILI9488_Write_Command_Data(0x88);
//          break;
//      }
//      //===================================================================================================
//      case LANDSCAPE_1:
//      {
//          ILI9488_Write_Command_Data(0x28);
//          break;
//      }
//      //===================================================================================================
//      case LANDSCAPE_2:
//      {
//          ILI9488_Write_Command_Data(0xE8);
//          break;
//      }
//      //===================================================================================================
//  }
//  //=======================================================================================================
//  if((Orientation_Mode == PORTRAIT_1) || (Orientation_Mode == PORTRAIT_2))
//  {
//      MAX_X = LCD_WITDH_SIZE;
//      MAX_Y = LCD_HIGH_SIZE;
//  }
//  //=======================================================================================================
//  if((Orientation_Mode == LANDSCAPE_1) || (Orientation_Mode == LANDSCAPE_2))
//  {
//      MAX_X = LCD_HIGH_SIZE;
//      MAX_Y = LCD_WITDH_SIZE;
//  }
//  //=======================================================================================================
//}
//===========================================================================================================
//===========================================================================================================
//===========================================================================================================
/**
    * @brief    Set Address Of Pointer
    * @param    + Address
    * @retval   None
    */
void ILI9488_Set_Address_Pointer(uint16_t X1, uint16_t Y1, uint16_t X2, uint16_t Y2)
{
    //=======================================================================================================
    ILI9488_Write_Command(ILI9488_Column_Address_Set);
    ILI9488_Write_Command_Data(X1 >> 8);
    ILI9488_Write_Command_Data(X1);
    ILI9488_Write_Command_Data(X2 >> 8);
    ILI9488_Write_Command_Data(X2);
    //=======================================================================================================
    ILI9488_Write_Command(ILI9488_Page_Address_Set);
    ILI9488_Write_Command_Data(Y1 >> 8);
    ILI9488_Write_Command_Data(Y1);
    ILI9488_Write_Command_Data(Y2 >> 8);
    ILI9488_Write_Command_Data(Y2);
    //=======================================================================================================
    ILI9488_Write_Command(ILI9488_Memory_Write);
    //=======================================================================================================
}
//===========================================================================================================
//===========================================================================================================
//===========================================================================================================
/**
    * @brief    Fill All LCD
    * @param    + Color
    * @retval   None
    */
void ILI9488_LCD_Fill(uint16_t Color)
{
    //=======================================================================================================
    uint32_t TempCounter = LCD_PIXEL_SIZE;
    //=======================================================================================================
    ILI9488_Set_Address_Pointer(0, 0, MAX_X - 1, MAX_Y - 1);
    //=======================================================================================================
    while (TempCounter)
    {
        ILI9488_Write_GRAM(Color);
        TempCounter = TempCounter - 1;
    };
    //=======================================================================================================
}
//===========================================================================================================
//===========================================================================================================
//===========================================================================================================
/**
    * @brief    Fill An Area Of LCD
    * @param    + Position of Area
                    + Color
    * @retval   None
    */
void ILI9488_LCD_Fill_Area(uint16_t X1, uint16_t Y1, uint16_t X2, uint16_t Y2, uint16_t Color)
{
    //=======================================================================================================
    uint32_t TempCounter = 0;
    uint8_t r, g, b;
    //========================================================================================================
    //  if ( x<0 ) return;
    //  if ( y<0 ) return;
    //========================================================================================================
    r = Color >> 16 & 0xFF;
    g = Color >> 8 & 0xFF;
    b = Color & 0xFF;

    r >>= 3;
    g >>= 2;
    b >>= 3;

    Color = b | (g << 5) | (r << 11);
    //=======================================================================================================
    if (X1 > X2)
    {
        Swap(&X1, &X2);
    }

    if (Y1 > Y2)
    {
        Swap(&Y1, &Y2);
    }
    //=======================================================================================================
    TempCounter = (X2 - X1) * (Y2 - Y1);
    //=======================================================================================================
    ILI9488_Set_Address_Pointer(X1, Y1, X2 - 1, Y2 - 1);
    //=======================================================================================================
    while (TempCounter)
    {
        ILI9488_Write_GRAM(Color);
        TempCounter = TempCounter - 1;
    };
    //=======================================================================================================
}
//===========================================================================================================
//===========================================================================================================
//===========================================================================================================
/**
    * @brief    Draw A Pixel
    * @param    + Position of Pixel
                    + Color
    * @retval   None
    */
void ILI9488_LCD_Draw_Pixel(uint16_t X, uint16_t Y, uint16_t Color)
{
    //=======================================================================================================
    ILI9488_Set_Address_Pointer(X, Y, X, Y);
    ILI9488_Write_GRAM(Color);
    //=======================================================================================================
}
//===========================================================================================================
//===========================================================================================================
//===========================================================================================================
/**
    * @brief    Draw Pixel with Size
    * @param    + Position of Bitmap
                    + Color
                    + Pixel's Size
    * @retval   None
    */
void ILI9488_LCD_Draw_Font_Pixel(uint16_t X, uint16_t Y, uint16_t Color, uint8_t Pixel_Size)
{
    //=======================================================================================================
    volatile uint8_t TempCounter = (Pixel_Size * Pixel_Size);
    //=======================================================================================================
    ILI9488_Set_Address_Pointer(X, Y, X + Pixel_Size - 1, Y + Pixel_Size - 1);
    //=======================================================================================================
    while (TempCounter > 0)
    {
        ILI9488_Write_GRAM(Color);
        TempCounter = TempCounter - 1;
    }
    //========================================================================================================
}
//===========================================================================================================
//===========================================================================================================
//===========================================================================================================
/**
    * @brief    Show Character
    * @param    + Position of Character
                    + Font Size
                    + Color
                    + BackGround Color
                    + Character
    * @retval   None
    */
void ILI9488_LCD_Show_Character(uint16_t X, uint16_t Y, uint8_t Font_Size, uint16_t Color, uint16_t Background_Color, uint8_t Character)
{
    //========================================================================================================
    volatile uint8_t i = 0;
    volatile uint8_t j = 0;
    volatile uint8_t value = 0;
    //========================================================================================================
    if (Font_Size <= 0)
    {
        Font_Size = 1;
    }
    //========================================================================================================
    if (X < Font_Size)
    {
        X = Font_Size;
    }
    //========================================================================================================
    for (i = 0x00; i < 0x05; i++)
    {
        //=====================================================================================================
        for (j = 0x00; j < 0x08; j++)
        {
            value = 0x0000;
            value = ((font[((unsigned char)Character) - 0x20][i]));

            if (((value >> j) & 0x01) != 0x00)
            {
                ILI9488_LCD_Draw_Font_Pixel(X, Y, Color, Font_Size);
            }
            else
            {
                ILI9488_LCD_Draw_Font_Pixel(X, Y, Background_Color, Font_Size);
            }

            Y = Y + Font_Size;
        }
        //=====================================================================================================
        Y = Y - (Font_Size << 0x03);
        X = X + Font_Size;
        //=====================================================================================================
    }
    //========================================================================================================
}
//===========================================================================================================
//===========================================================================================================
//===========================================================================================================
/**
    * @brief    Show String
    * @param    + Position of Character
                    + Font Size
                    + Color
                    + BackGround Color
                    + Character
    * @retval   None
    */
void ILI9488_LCD_Show_String(uint16_t X, uint16_t Y, uint8_t Font_Size, uint16_t Color, uint16_t Background_Color, uint8_t *String)
{
    //========================================================================================================
    do
    {
        ILI9488_LCD_Show_Character(X, Y, Font_Size, Color, Background_Color, *String++);
        X = X + (Font_Size * 0x06);
    } while ((*String >= 0x20) && (*String <= 0x7F));
    //========================================================================================================
}
//===========================================================================================================
//===========================================================================================================
//===========================================================================================================
/**
    * @brief    Writes Command to Draw Bitmap
    * @param    + Position of Bitmap
                    + Bitmap Array
    * @retval   None
    */
void ILI9488_LCD_Draw_BMP(uint16_t X1, uint16_t Y1, uint16_t X2, uint16_t Y2, const uint16_t *Bitmap)
{
    //=======================================================================================================
    uint32_t Size = 0;
    uint32_t TempCounter = 0;
    //=======================================================================================================
    if (X1 > X2)
    {
        Swap(&X1, &X2);
    }

    if (Y1 > Y2)
    {
        Swap(&Y1, &Y2);
    }
    //=======================================================================================================
    Size = (X2 - X1) * (Y2 - Y1);
    //=======================================================================================================
    ILI9488_Set_Address_Pointer(X1, Y1, (X2 - 1), (Y2 - 1));

    for (TempCounter = 0; TempCounter < Size; TempCounter++)
    {
        ILI9488_Write_GRAM(*Bitmap++);
    }
    //========================================================================================================
}

//===========================================================================================================
//===========================================================================================================
//===========================================================================================================
/**
    * @brief    Display On ILI9488
    * @param    None
    * @retval   None
    */
void ILI9488_DisplayOn(void)
{
    //========================================================================================================
    ILI9488_Write_Command(ILI9488_Display_ON);
    //========================================================================================================
}
//===========================================================================================================
//===========================================================================================================
//===========================================================================================================
/**
    * @brief    Display Off ILI9488
    * @param    None
    * @retval   None
    */
void ILI9488_DisplayOff(void)
{
    //========================================================================================================
    ILI9488_Write_Command(ILI9488_Display_OFF);
    //========================================================================================================
}
//===========================================================================================================
//===========================================================================================================
//===========================================================================================================
